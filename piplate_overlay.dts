/dts-v1/;
/plugin/;

/ {
	compatible = "brcm,bcm2708";
	fragment@0 {
		target = <&spi0>;
		__overlay__ {
			#address-cells = <1>;
			#size-cells = <0>;			
			piplate@0{
				compatible = "piplate";
				reg = <1>;
				spi-max-frequency = <1000000>;
			};
		};
	};	
};
